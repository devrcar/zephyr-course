## Kconfig
```
menuconfig LED_SUBSYSTEM
    bool "LED Subsystem"
    default y

if LED_SUBSYSTEM
    choice
        prompt "LED blink sleep time (1s (medium))"
        default BLINK_SLEEP_1000MS

        config BLINK_SLEEP_250MS
            bool "Fast blink (250ms)"
        config BLINK_SLEEP_500MS
            bool "Medium blink (500ms)"
        config BLINK_SLEEP_1000MS
            bool "Slow blink (1000ms)"
        config BLINK_SLEEP_2000MS
            bool "Very slow blink (2000ms)"
    endchoice

    config LED_BLINK_SLEEP_TIME
        int
        default 250 if BLINK_SLEEP_250MS
        default 500 if BLINK_SLEEP_500MS
        default 1000 if BLINK_SLEEP_1000MS
        default 2000 if BLINK_SLEEP_2000MS
        help
            LED blink sleep time in milliseconds

    menuconfig ADVANCED_LED_SETTINGS
        bool "Advanced LED settings"
        default n

    if ADVANCED_LED_SETTINGS
        config LED_BRIGHTNESS
            int "LED brightness level"
            default 100
            range 0 100
            help
                LED brightness level (0-100)
        config LED_FADING
            int "LED fade duration (ms)"
            default 500
            range 0 5000
            help
                Duration of the LED fade effect in milliseconds.

        menu "Expert Settings"
            visible if ADVANCED_LED_SETTINGS

        config LED_DEBUG
            bool "Enable LED debugging"
            default n
            help
                Enable debugging output for the LED subsystem.
        config CUSTOM_BLINK
            bool "Custom blink pattern"
            default n
            help
                Enable custom LED blinking patterns.

        endmenu
    endif # ADVANCED_LED_SETTINGS
endif # LED_SUBSYSTEM

menu "Zephyr Configuration"
    source "Kconfig.zephyr"
endmenu
```

## prj.conf
```kconfig
CONFIG_GPIO=y
CONFIG_LOG=y

# CONFIG_LED_BLINKING_PERIOD=1000
```

## src/main.cpp
```c
#include <zephyr/drivers/gpio.h>
#include <zephyr/kernel.h>
#include <zephyr/logging/log.h>

#define SLEEP_TIME_MS CONFIG_LED_BLINK_SLEEP_TIME

/* The devicetree node identifier for the "led0" alias. */
#define LED_NODE DT_ALIAS(led0)

static const struct gpio_dt_spec led = GPIO_DT_SPEC_GET(LED_NODE, gpios);

LOG_MODULE_REGISTER(main, LOG_LEVEL_INF);

int main(void)
{
    bool led_state = true;

    if (!gpio_is_ready_dt(&led)) return 0;

    if (gpio_pin_configure_dt(&led, GPIO_OUTPUT_ACTIVE) < 0) return 0;

    while (1) {
        if (gpio_pin_toggle_dt(&led) < 0) return 0;

        led_state = !led_state;
        LOG_INF("LED state: %s", led_state ? "ON" : "OFF");
        k_msleep(SLEEP_TIME_MS);
    }
    return 0;
}
```
